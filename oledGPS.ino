/*

  oledGPS.ino

  OLED_gps was written as a GPS GUI (Graphics User Interface) and is intended for edgucational purposes only. The output
  is not usable for navigation of any sort. I programmed the GUI to display as much information as a 128x64 display could
  handle. This code was written by Greg Stievenart with no claim to the information provided in this code. Please feel
  free to copy, modify and share. Freely published August 18, 2025.

  This project is posted at: https://forum.arduino.cc/t/oled-gps-yet-another-gui/1403413

*/

#include <SoftwareSerial.h>               // built-in with Arduino IDE
#include <TinyGPS++.h>                    // https://github.com/mikalhart/TinyGPSPlus/tree/master/src

static const int RXPin = 4, TXPin = 3;
static const uint32_t GPSBaud = 9600;

SoftwareSerial SoftSerial(RXPin, TXPin);  // moves TX and RX to selected pins
TinyGPSPlus gps;                          // initiates TinyGPS library

#include <Wire.h>                         // built-in with Arduino IDE
#include <SPI.h>                          // built-in with Arduino IDE
#include <Adafruit_GFX.h>                 // https://github.com/adafruit/Adafruit-GFX-Library
#include <Adafruit_SH1106.h>              // https://github.com/wonho-maker/Adafruit_SH1106

#define OLED_RESET -1                     // reset required for SH1106

Adafruit_SH1106 display(OLED_RESET);      // reset required for SH1106

unsigned long previousMillis_cursor = 0;
const long display_cursor = 1000;         // time to refresh location dot.
const int time_adjustment = -4;           // hour adjustment to shift UTC time zone.

static const unsigned char PROGMEM world[832] = {               // array used for backgroup map
  0x00, 0x00, 0x00, 0x00, 0x00, 0x00, 0x00, 0x00, 0x00, 0x00, 0x00, 0x00, 0x00, 0x00, 0x00, 0x00,
  0x00, 0x7C, 0x00, 0x00, 0x00, 0x00, 0x00, 0x00, 0x00, 0x00, 0x00, 0x00, 0x00, 0x78, 0x84, 0x00,
  0x00, 0x00, 0x00, 0x00, 0x00, 0x00, 0x00, 0x00, 0x00, 0x03, 0x85, 0x0C, 0xC0, 0x00, 0x00, 0x00,
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  0x0E, 0x00, 0x00, 0x00, 0x00, 0x00, 0x08, 0x00, 0x00, 0x00, 0x20, 0x00, 0x00, 0x01, 0x00, 0x00 
};

void setup() {

  display.begin(SH1106_SWITCHCAPVCC, 0x3C);         // initiates display
  display.setTextColor(WHITE);                      // sets all text to the color white.
  display.setTextSize(0);                           // sets all text to size zero.
  display.clearDisplay();                           // clears display.
  Serial.begin(115200);                             // initiates serial channel.
  SoftSerial.begin(GPSBaud);                        // initiates second serial channel names SoftSerial.
}

void loop() {

  unsigned long currentMillis = millis();
  int Htext = 100;                                  // one varible for sidebar text.
  char* ampm = "AM";                                // ante meridiem (AM) or post meridiem (PM).

  while (SoftSerial.available() > 0) {              // waits until GPS data is avaialable.
    gps.encode(SoftSerial.read());                  // read GPS information
  }

  int utc_hour = gps.time.hour();                   // call for UTC hour of the day.
  int minute = gps.time.minute();                   // call for GPS minutes data.
  int latitude = gps.location.lat();                // calls for GPS Latitude.
  int longitude = gps.location.lng();               // calls for GPS Longitude.
  int altitude = gps.altitude.meters();             // calls for GPS Altitude.
  int satellites = gps.satellites.value();          // calls for GPS Number of satellites.
  int hour = utc_hour;

  display.clearDisplay();                           // clears display
  display.drawBitmap(0, 0, world, 104, 64, WHITE);  // draws world map

  if (hour > 24) {                                 // adjust UTC hours to display correctly.
    hour = hour - 24;
    if (hour < 0) {
      hour = hour + 24;
    }
  }

  hour = hour + time_adjustment;                    // adds time adjustment for your time zone.

  if (hour >= 12) {                                 // changes military time to twelve hour time.
    hour = hour - 12;
    ampm = "PM";                                    // post meridiem (PM).
  } else {
    ampm = "AM";                                    // ante meridiem (AM).
  }

  if (hour <= 0) {
    hour = hour + 12;
    ampm = "PM";
    if (hour == 12) {
      ampm = "AM";
    }
  }

  if ( hour >= 10 ) {
    display.setCursor(84, 1);                       // justifies double digit location.
  } else {
    display.setCursor(92, 1);                       // justifies single digit location.
  }

  display.print(hour);                              // writes hour of day.

  if (minute >= 10) {
    display.print(":");                             // justifies double digit location.
  } else {
    display.print(":0");                            // adds zero for minutes under ten.
  }

  display.print(minute);                            // writes minutes from GPS data.
  display.print(ampm);                              // displays AM or PM text.
  display.setCursor(Htext, 20);                     // sets cursor location on screen.
  display.print(abs(latitude));                     // writes latitude from GPS data.
  display.print((char)247);                         // writes degree symbol (°).

  if (latitude > 0) {
    display.print("N");                             // displays latitude direction.
  } else {
    display.print("S");                             // displays latitude direction.
  }

  display.setCursor(Htext, 30);                     // sets cursor location on screen.
  display.print(abs(longitude));                    // writes longitude.
  display.print((char)247);                         // writes degree symbol (°).

  if (longitude > 0) {
    display.print("E");                             // displays longitude direction.
  } else {
    display.print("W");                             // displays longitude direction.
  }

  display.setCursor(Htext, 45);                     // sets cursor location on screen.
  display.print("ALT");
  display.setCursor(Htext, 55);                     // sets cursor location on screen.
  display.print(altitude);                          // writes altitude in meters
  display.print("m");

  if (satellites >= 10) {
    display.setCursor(5, 55);                       // centers single digit location.
  } else {
    display.setCursor(8, 55);                       // centers double digit location.
  }

  display.print(satellites);                        // writes number of satellites.

  if (currentMillis - previousMillis_cursor >= display_cursor) {
    previousMillis_cursor = currentMillis;

    int lat = 40 - (latitude / 3.6);                // 40th pixel is where the Equator (0°) is located.
    int lng = 46 + (longitude / 3.6);               // 46th pixel is where Greenwich, London is located.
    display.fillCircle(lng, lat, 2, WHITE);         // draws flashing location dot.
    display.fillCircle(lng, lat, 1, BLACK);         // contrasting black inter-circle for map outlines.
  }

  display.display();                                // displays new screen information.
}
